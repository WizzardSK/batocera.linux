## package/batocera/emulators/retroarch/libretro/libretro-freej2me/Config.in
```kconfig
config BR2_PACKAGE_LIBRETRO_FREEJ2ME
	bool "libretro-freej2me"
	depends on BR2_PACKAGE_OPENJDK_ARCH_SUPPORTS # openjdk
	depends on BR2_PACKAGE_HOST_OPENJDK_BIN_ARCH_SUPPORTS # host-openjdk
	depends on !BR2_SOFT_FLOAT # openjdk
	depends on !BR2_STATIC_LIBS # openjdk
	depends on BR2_INSTALL_LIBSTDCPP # openjdk
	depends on BR2_TOOLCHAIN_HAS_THREADS # openjdk
	depends on BR2_TOOLCHAIN_USES_GLIBC # openjdk
	depends on BR2_USE_MMU # openjdk
	select BR2_PACKAGE_OPENJDK # runtime: the core shells out to "java"
	help
	  FreeJ2ME-Plus is a J2ME emulator with a libretro frontend.
	  The core is a thin C shim that invokes a Java runtime to run
	  freej2me-lr.jar (installed as a BIOS) against J2ME .jar/.jad
	  applications.

	  https://github.com/TASEmulators/freej2me-plus

comment "libretro-freej2me needs a glibc toolchain w/ C++, threads, dynamic library (for openjdk)"
	depends on BR2_PACKAGE_OPENJDK_ARCH_SUPPORTS
	depends on !BR2_SOFT_FLOAT
	depends on BR2_USE_MMU
	depends on !(BR2_INSTALL_LIBSTDCPP && !BR2_STATIC_LIBS \
		&& BR2_TOOLCHAIN_HAS_THREADS && BR2_TOOLCHAIN_USES_GLIBC)
```

## package/batocera/emulators/retroarch/libretro/libretro-squirreljme/Config.in
```kconfig
config BR2_PACKAGE_LIBRETRO_SQUIRRELJME
	bool "libretro-squirreljme"
	help
	  SquirrelJME is a Java ME 8 virtual machine for embedded and
	  IoT devices, packaged here as a libretro core (NanoCoat) to
	  run J2ME (.jar/.jad) applications.

	  https://squirreljme.cc
```
